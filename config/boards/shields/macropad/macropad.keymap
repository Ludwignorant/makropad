#include <behaviors.dtsi>
#include <dt-bindings/zmk/keys.h>
#include <dt-bindings/zmk/bt.h>
#include <dt-bindings/zmk/outputs.h>
 
#define DEFAULT 0
#define LOWER   1

/ {
	
    keymap {
        compatible = "zmk,keymap";
 
        default_layer {
            bindings = <
                &kp KP_N0  &kp KP_N1  &kp KP_N2  &kp KP_N3  &kp KP_N4  &kp KP_N5  &kp KP_N6  &kp KP_N7  &kp KP_N8  &kp KP_N9  &mo LOWER
            >;
        };
		
		lower_layer {
            bindings = <
				&kp KP_ENTER  &none  &none  &bt BT_CLR  &kp KP_MINUS  &kp KP_DIVIDE  &none  &kp KP_PLUS  &kp KP_MULTIPLY  &none  &trans
            >;
        };
    };
};