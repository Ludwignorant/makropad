/ {
    chosen {
        zmk,kscan = &default_kscan;
    };
 
    default_kscan: kscan {
        compatible = "zmk,kscan-gpio-direct";
        label = "default_kscan";
 
        input-gpios =
            <&xiao_d 0 (GPIO_ACTIVE_HIGH | GPIO_PULL_UP)>,
			<&xiao_d 1 (GPIO_ACTIVE_HIGH | GPIO_PULL_UP)>,
            <&xiao_d 2 (GPIO_ACTIVE_HIGH | GPIO_PULL_UP)>,
            <&xiao_d 3 (GPIO_ACTIVE_HIGH | GPIO_PULL_UP)>,
            <&xiao_d 4 (GPIO_ACTIVE_HIGH | GPIO_PULL_UP)>,
            <&xiao_d 5 (GPIO_ACTIVE_HIGH | GPIO_PULL_UP)>,
            <&xiao_d 6 (GPIO_ACTIVE_HIGH | GPIO_PULL_UP)>,
            <&xiao_d 7 (GPIO_ACTIVE_HIGH | GPIO_PULL_UP)>,
            <&xiao_d 8 (GPIO_ACTIVE_HIGH | GPIO_PULL_UP)>,
            <&xiao_d 9 (GPIO_ACTIVE_HIGH | GPIO_PULL_UP)>;
    };
};